## components/task/Kconfig.projbuild
```kconfig
menu "API Configuration"

    config WEB_SERVER
        string "Web Server"
        default "api.darksky.net"
        help 
            Web Server to connect and get weather data

    config WEB_PORT
        int "Web Port"
        default 443
        help 
            Web Server Port to connect and get weather data

    config API_KEY
        string "API Key"
        default "d1e8cbd61876b713aec0eeed353e01"
        help 
            API Key to Web Server

    config LATITUDE
        string "Latitude"
        default "40.653"
        help 
            Latitude 

    config LONGITUDE
        string "Longtitude"
        default "-73.968"
        help 
            Longitude

endmenu
```

## main/Kconfig.projbuild
```kconfig
menu "Example Configuration"
    config ESP_WIFI_SSID
        string "Wifi SSID"
        default "myssid"
        help 
            SSID (Network name) for the example to connect
    config ESP_WIFI_PASSWORD
        string "Wifi Password"
        default "mypassword"
        help
            Wifi Password for the example to connect
endmenu
```
